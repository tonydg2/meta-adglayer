## conf/layer.conf
```bitbake
# We have a conf and classes directory, add to BBPATH
BBPATH .= ":${LAYERDIR}"

# We have recipes-* directories, add to BBFILES
BBFILES += "${LAYERDIR}/recipes-*/*/*.bb \
            ${LAYERDIR}/recipes-*/*/*.bbappend"

BBFILE_COLLECTIONS += "adglayer"
BBFILE_PATTERN_adglayer = "^${LAYERDIR}/"
BBFILE_PRIORITY_adglayer = "6"
LAYERVERSION_adglayer = "1"
LAYERDEPENDS_adglayer = "core"
LAYERSERIES_COMPAT_adglayer = "langdale"
IMAGE_INSTALL:append = " testapp1 test-app2"
```
